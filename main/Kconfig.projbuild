## main/Kconfig.projbuild
```kconfig
menu "ヘッドボードLED"

config HEADBOARD_USB_SETUP
    bool "USB から設定を変更できるようにする（開発用）"
    default n
    help
        有効にすると、USB 接続の設定ページから Wi-Fi・MQTT などを変更できます。
        量産版では無効にし、Bluetooth（Wi-Fi）と本体の設定ページ（その他）で設定します。
        無効でも、USB からの状態表示・ログ・ラベル表示・点灯テストは使えます。

config HEADBOARD_UPDATE_URL
    string "ファームウェアの配布元（Home Assistant からの更新用）"
    default "https://yamadamasanori.github.io/headboard/"
    help
        manifest.json と firmware/headboard-led-ota.bin を置いた URL（末尾は /）。
        本体が 6 時間ごとに manifest.json を見て新しい版を探し、Home Assistant の
        「更新」から書き込めるようにします。空にすると、この機能を使いません。
        HTTPS で取得し、サーバーの証明書を確かめます。

endmenu
```

## sdkconfig.defaults
```kconfig
# 共通の設定。ESP32-S3 N16R8 用の設定は sdkconfig.defaults.esp32s3
CONFIG_PARTITION_TABLE_CUSTOM=y
CONFIG_PARTITION_TABLE_CUSTOM_FILENAME="partitions.csv"
CONFIG_ESP_CONSOLE_UART_DEFAULT=y
CONFIG_ESP_CONSOLE_UART_BAUDRATE=115200
# ログは UART（COM 端子）だけに出す。USB 端子へは設定用の応答だけを送る（console.c）
CONFIG_ESP_CONSOLE_SECONDARY_NONE=y
CONFIG_LOG_DEFAULT_LEVEL_INFO=y
CONFIG_FREERTOS_HZ=1000
CONFIG_ESP_MAIN_TASK_STACK_SIZE=4096
# Wi-Fi の接続イベントの中で MQTT・設定ページ・mDNS を始めるため、既定（2304）より大きくする
CONFIG_ESP_SYSTEM_EVENT_TASK_STACK_SIZE=4096
# OTA で書き込んだファームウェアが起動できなかったら、前のものに戻す
CONFIG_BOOTLOADER_APP_ROLLBACK_ENABLE=y

# ---- Bluetooth（Wi-Fi の設定用。設定が終わったら止めてメモリを返す） ----
CONFIG_BT_ENABLED=y
CONFIG_BT_NIMBLE_ENABLED=y
CONFIG_BT_NIMBLE_ROLE_CENTRAL=n
CONFIG_BT_NIMBLE_ROLE_OBSERVER=n
CONFIG_BT_NIMBLE_MAX_CONNECTIONS=1

# ---- 本体の設定ページ ----
CONFIG_HTTPD_WS_SUPPORT=y
# ブラウザのリクエストヘッダが既定の 512 バイトを超えることがあるため
CONFIG_HTTPD_MAX_REQ_HDR_LEN=1024
CONFIG_HTTPD_MAX_URI_LEN=256

# ---- Tailscale (MicroLink) ----
CONFIG_ML_ENABLE_CONFIG_HTTPD=n
# WireGuard / Noise に必要な設定
CONFIG_LWIP_MAX_SOCKETS=16
CONFIG_LWIP_SO_RCVBUF=y
CONFIG_LWIP_TCPIP_RECVMBOX_SIZE=64
CONFIG_MBEDTLS_CHACHA20_C=y
CONFIG_MBEDTLS_POLY1305_C=y
CONFIG_MBEDTLS_CHACHAPOLY_C=y
CONFIG_MBEDTLS_HKDF_C=y
CONFIG_ESP_DEFAULT_CPU_FREQ_MHZ_240=y
CONFIG_ESP_TASK_WDT_TIMEOUT_S=30
CONFIG_FREERTOS_TIMER_TASK_STACK_DEPTH=4096

# ---- ファームウェアの署名（Secure Boot は使わない。eFuse は書かない） ----
# 無線での更新（設定ページ・Home Assistant）のとき、今動いている版と同じ鍵で署名されているか確かめる。
# 秘密鍵はリポジトリに入れない（secrets/ は .gitignore 済み）。公開鍵は keys/ に置く
CONFIG_SECURE_SIGNED_APPS_NO_SECURE_BOOT=y
CONFIG_SECURE_SIGNED_APPS_RSA_SCHEME=y
CONFIG_SECURE_SIGNED_ON_UPDATE_NO_SECURE_BOOT=y
CONFIG_SECURE_BOOT_BUILD_SIGNED_BINARIES=y
CONFIG_SECURE_BOOT_SIGNING_KEY="secrets/headboard-signing-key.pem"
```

## sdkconfig.defaults.esp32s3
```kconfig
# ESP32-S3 用。対応するボード（N16R8、XIAO ESP32S3）はどちらもオクタル PSRAM 8MB を持つ。
# フラッシュの大きさなど、ボードごとの設定は sdkconfig.defaults.n16r8 / sdkconfig.defaults.xiao
CONFIG_ESPTOOLPY_FLASHMODE_QIO=y
CONFIG_SPIRAM=y
CONFIG_SPIRAM_MODE_OCT=y
CONFIG_SPIRAM_SPEED_80M=y
CONFIG_SPIRAM_TRY_ALLOCATE_WIFI_LWIP=y
# PSRAM に余裕があるので、Tailscale は MicroLink の標準値で使う
CONFIG_ML_H2_BUFFER_SIZE_KB=512
CONFIG_ML_JSON_BUFFER_SIZE_KB=512
CONFIG_ML_MAX_PEERS=16
CONFIG_ML_NVS_MAX_PEERS=64
# Bluetooth のメモリは PSRAM から取る
CONFIG_BT_NIMBLE_MEM_ALLOC_MODE_EXTERNAL=y
```

## sdkconfig.defaults.n16r8
```kconfig
# ESP32-S3 N16R8（DevKitC-1 互換。フラッシュ 16MB、状態表示は基板上のフルカラー LED）
CONFIG_HEADBOARD_BOARD_N16R8=y
CONFIG_ESPTOOLPY_FLASHSIZE_16MB=y
```
